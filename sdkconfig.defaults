## sdkconfig.defaults
```kconfig
CONFIG_IDF_TARGET="esp32s3"
CONFIG_ESP_DEFAULT_CPU_FREQ_MHZ_240=y
CONFIG_ESP32S3_INSTRUCTION_CACHE_32KB=y
CONFIG_ESP32S3_DATA_CACHE_64KB=y
CONFIG_ESP32S3_DATA_CACHE_LINE_64B=y
CONFIG_ESPTOOLPY_FLASHSIZE_16MB=y
CONFIG_SPIRAM=y
CONFIG_SPIRAM_MODE_OCT=y
CONFIG_SPIRAM_SPEED_80M=y
CONFIG_ESP_CONSOLE_USB_SERIAL_JTAG=y
CONFIG_ESP_MAIN_TASK_STACK_SIZE=10240
CONFIG_CODEC_ES8311_SUPPORT=y
CONFIG_CODEC_I2C_BACKWARD_COMPATIBLE=n
CONFIG_PARTITION_TABLE_CUSTOM=y
CONFIG_PARTITION_TABLE_CUSTOM_FILENAME="partitions.csv"
CONFIG_COMPILER_OPTIMIZATION_SIZE=y
CONFIG_OPUS_FLOATING_POINT=n
CONFIG_ESP_WS_CLIENT_SEPARATE_TX_LOCK=y
CONFIG_LWIP_TCPIP_RECVMBOX_SIZE=16
CONFIG_SR_WN_WN9_XIAOLUXIAOLU_TTS2=y
# 没有内置 OTA 服务：信息地址由配网页逐台填写，空值让 get_info() 直接报错
CONFIG_XIAOZHI_OTA_URL=""
# 系统时间由 SNTP 统一同步，禁止 OTA 接口用含时区偏移的 server_time 覆盖 UTC 时钟
CONFIG_XIAOZHI_SYNC_SYSTEM_TIME_FROM_SERVER=n
```
